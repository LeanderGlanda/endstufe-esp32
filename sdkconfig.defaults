## sdkconfig.defaults
```kconfig
# Rust often needs a bit of an extra main task stack size compared to C (the default is 3K)
CONFIG_ESP_MAIN_TASK_STACK_SIZE=8000

# Use this to set FreeRTOS kernel tick frequency to 1000 Hz (100 Hz by default).
# This allows to use 1 ms granularity for thread sleeps (10 ms by default).
#CONFIG_FREERTOS_HZ=1000

# Workaround for https://github.com/espressif/esp-idf/issues/7631
#CONFIG_MBEDTLS_CERTIFICATE_BUNDLE=n
#CONFIG_MBEDTLS_CERTIFICATE_BUNDLE_DEFAULT_FULL=n
# CONFIG_LOG_DEFAULT_LEVEL_DEBUG=y
# CONFIG_LOG_MAXIMUM_LEVEL_DEBUG=y

#CONFIG_ESPTOOLPY_FLASHSIZE_16MB=y
#CONFIG_SPIRAM_SIZE=8388608
#CONFIG_SPIRAM_SUPPORT=y        # Enable PSRAM support
#CONFIG_SPIRAM_BOOT_INIT=y

# CONFIG_PARTITION_TABLE_CUSTOM=y
# CONFIG_PARTITION_TABLE_CUSTOM_FILENAME="partitions.csv"
```
